## drivers/kernelsu/Kconfig
```kconfig
menu "KernelSU"

config KSU
    tristate "KernelSU function support"
    depends on KPROBES && EXT4_FS
    default y
    help
      Enable kernel-level root privileges on Android System.
      Requires CONFIG_KPROBES for kernel hooking support.
      Requires CONFIG_EXT4_FS for `ext4_unregister_sysfs`.

config KSU_DEBUG
    bool "KernelSU debug mode"
    depends on KSU
    default n
    help
      Enable KernelSU debug mode.

config KSU_ALLOWLIST_WORKAROUND
    bool "KernelSU allowlist workaround"
    depends on KSU
    default n
    help
      Enable workaround for broken allowlist save

config KSU_MANUAL_HOOK
    bool "KernelSU manual hook mode."
    depends on KSU
    default y if !KPROBES
    default n
    help
      Enable manual hook support.

config KSU_KPROBES_HOOK
    bool "KernelSU tracepoint+kretprobe hook"
    depends on KSU && KRETPROBES && KPROBES && HAVE_SYSCALL_TRACEPOINTS
    default y if KPROBES && KRETPROBES && HAVE_SYSCALL_TRACEPOINTS
    help
      Enable KPROBES, KRETPROBES and TRACEPOINT hook for KernelSU core.
      This should not be used on kernel below 5.10.

endmenu
```
